## CMakeLists.txt
```
# SPDX-License-Identifier: Apache-2.0

cmake_minimum_required(VERSION 3.28.0)
find_package(Zephyr REQUIRED HINTS $ENV{ZEPHYR_BASE})
project(http_client_multiprotocol_http3)

target_sources(app PRIVATE src/main.c src/qpack.c ../http2/src/common.c)
target_include_directories(app PRIVATE ../http2/src ${ZEPHYR_BASE}/tests/net/lib/quic/certs
  ${ZEPHYR_BASE}/subsys/net/lib/http/headers)

set(gen_dir ${ZEPHYR_BINARY_DIR}/include/generated/)

foreach(inc_file ca.crt server.crt server.key client.crt client.key)
  generate_inc_file_for_target(app ${ZEPHYR_BASE}/tests/net/lib/quic/certs/${inc_file}
    ${gen_dir}/${inc_file}.inc)
endforeach()

zephyr_linker_sources(SECTIONS sections-rom.ld)
zephyr_iterable_section(NAME http_resource_desc_test_http_service KVMA RAM_REGION GROUP RODATA_REGION)
```

## prj.conf
```kconfig
CONFIG_ZTEST=y
CONFIG_ZTEST_STACK_SIZE=8192
CONFIG_NET_TEST=y
CONFIG_ENTROPY_GENERATOR=y
CONFIG_TEST_RANDOM_GENERATOR=y
CONFIG_EVENTFD=y
CONFIG_MAIN_STACK_SIZE=4096

# Networking
CONFIG_NETWORKING=y
CONFIG_NET_DRIVERS=y
CONFIG_NET_LOOPBACK=y
CONFIG_NET_LOOPBACK_MTU=1280
CONFIG_NET_IPV4=y
CONFIG_NET_UDP=y
CONFIG_NET_TCP=y
CONFIG_NET_SOCKETS=y
CONFIG_NET_SOCKETS_SOCKOPT_TLS=y
CONFIG_NET_SOCKETS_SERVICE_STACK_SIZE=8192
CONFIG_ZVFS_POLL_MAX=24
CONFIG_ZVFS_OPEN_ADD_SIZE_NET=24
CONFIG_NET_BUF_RX_COUNT=256
CONFIG_NET_BUF_TX_COUNT=256
CONFIG_NET_PKT_RX_COUNT=64
CONFIG_NET_PKT_TX_COUNT=64
CONFIG_NET_MAX_CONTEXTS=12
CONFIG_NET_MAX_CONN=12
CONFIG_NET_CONTEXT_RCVTIMEO=y

# Client under test
CONFIG_HTTP_CLIENT_MULTIPROTOCOL=y
CONFIG_HTTP_CLIENT_MAX_STREAMS=4
CONFIG_HTTP_CLIENT_WORKQUEUE_STACK_SIZE=4096

# Zephyr HTTP server as the peer
CONFIG_HTTP_SERVER=y
CONFIG_HTTP_SERVER_VERSION_1=n
CONFIG_HTTP_SERVER_VERSION_2=n
CONFIG_HTTP_SERVER_VERSION_3=y
CONFIG_HTTP_SERVER_CAPTURE_HEADERS=y
CONFIG_HTTP_SERVER_CAPTURE_HEADER_COUNT=4
CONFIG_HTTP_SERVER_MAX_STREAMS=8
CONFIG_HTTP_SERVER_STACK_SIZE=8192
# Takes whole DATA frames of a request
CONFIG_HTTP_SERVER_CLIENT_BUFFER_SIZE=2048

# QUIC, for both ends
CONFIG_QUIC=y
CONFIG_QUIC_MAX_CONTEXTS=4
CONFIG_QUIC_MAX_ENDPOINTS=4
CONFIG_QUIC_MAX_STREAMS_BIDI=8
CONFIG_QUIC_MAX_STREAMS_UNI=8
CONFIG_QUIC_INITIAL_MAX_STREAMS_BIDI=8
CONFIG_QUIC_INITIAL_MAX_STREAMS_UNI=8
CONFIG_QUIC_PKT_COUNT=32
# The server's HTTP/3 stream ends a response early when flow control blocks
# it at the end of the request, so the test body has to fit the window.
CONFIG_QUIC_STREAM_TX_BUFFER_SIZE=32768
CONFIG_QUIC_STREAM_RX_BUFFER_SIZE=32768
CONFIG_QUIC_INITIAL_MAX_DATA=65536

CONFIG_TLS_CREDENTIALS=y
CONFIG_MBEDTLS_ENABLE_HEAP=y
CONFIG_MBEDTLS_HEAP_SIZE=65536
CONFIG_MBEDTLS_PSA_KEY_SLOT_COUNT=48
CONFIG_MBEDTLS_SSL_ALPN=y
CONFIG_TLS_MAX_CREDENTIALS_NUMBER=8
CONFIG_NET_SOCKETS_TLS_MAX_CONTEXTS=6

CONFIG_NET_LOG=y
```

## src/main.c
```c
/*
 * Copyright (c) 2026 Nordic Semiconductor ASA
 *
 * SPDX-License-Identifier: Apache-2.0
 */

/* End-to-end HTTP/3 tests against the Zephyr HTTP server over QUIC on loopback. */

#include <strings.h>

#include <zephyr/misc/lorem_ipsum.h>
#include <zephyr/net/http/server.h>
#include <zephyr/net/http/service.h>
#include <zephyr/net/socket.h>
#include <zephyr/net/tls_credentials.h>
#include <zephyr/ztest.h>

#include "common.h"

#define SERVER_ADDR "127.0.0.1"
#define SERVER_PORT 8443
/* The name the test server certificate is issued for. */
#define SERVER_HOST "localhost"

#define BODY_BUF_SIZE       (24 * 1024)
#define LARGE_BODY_SIZE     (20 * 1024)
#define LARGE_BODY_CHUNK    1000
#define UPLOAD_SIZE         2048
#define UPLOAD_PATTERN_SIZE 1500
#define REQ_HEADERS_MAX     4

static uint16_t test_http_service_port = SERVER_PORT;

#include "certificate.h"

static const sec_tag_t server_tag_list[] = {
	SERVER_CERTIFICATE_TAG,
};

static const sec_tag_t client_tag_list[] = {
	CA_CERTIFICATE_TAG,
};

static const struct http_service_config test_http_service_cfg = {
	.http_ver = HTTP_VERSION_3,
};

HTTPS_SERVICE_DEFINE(test_http_service, SERVER_ADDR, &test_http_service_port, 4, 10, NULL, NULL,
		     &test_http_service_cfg, server_tag_list, sizeof(server_tag_list));

/* Static resource */

static const char static_payload[] = LOREM_IPSUM_SHORT;

static struct http_resource_detail_static static_detail = {
	.common = {
		.type = HTTP_RESOURCE_TYPE_STATIC,
		.bitmask_of_supported_http_methods = BIT(HTTP_GET),
		.content_type = "text/plain",
	},
	.static_data = static_payload,
	.static_data_len = sizeof(static_payload) - 1,
};

HTTP_RESOURCE_DEFINE(static_resource, test_http_service, "/static", &static_detail);

/* Dynamic resource, driven by per-test settings */

static struct {
	uint16_t status;
	const uint8_t *body;
	size_t body_len;
	size_t chunk;
	const struct http_header *headers;
	size_t header_count;
	uint8_t upload[UPLOAD_SIZE];
	size_t upload_len;
	struct test_header req_headers[REQ_HEADERS_MAX];
	size_t req_header_count;
	size_t offset;
} dyn;

HTTP_SERVER_REGISTER_HEADER_CAPTURE(capture_test_header, "Test-Header");
HTTP_SERVER_REGISTER_HEADER_CAPTURE(capture_test_header2, "Test-Header2");

static void dyn_reset(void)
{
	memset(&dyn, 0, sizeof(dyn));
	dyn.status = HTTP_200_OK;
}

static const char *dyn_request_header(const char *name)
{
	for (size_t i = 0; i < dyn.req_header_count; i++) {
		if (strcasecmp(dyn.req_headers[i].name, name) == 0) {
			return dyn.req_headers[i].value;
		}
	}

	return NULL;
}

static void dyn_capture_request_headers(const struct http_request_ctx *request_ctx)
{
	for (size_t i = 0; i < request_ctx->header_count; i++) {
		struct test_header *hdr;

		if (dyn.req_header_count >= REQ_HEADERS_MAX) {
			break;
		}

		hdr = &dyn.req_headers[dyn.req_header_count++];
		strncpy(hdr->name, request_ctx->headers[i].name, sizeof(hdr->name) - 1);
		strncpy(hdr->value, request_ctx->headers[i].value, sizeof(hdr->value) - 1);
	}
}

static int dynamic_cb(struct http_client_ctx *client, enum http_transaction_status status,
		      const struct http_request_ctx *request_ctx,
		      struct http_response_ctx *response_ctx, void *user_data)
{
	ARG_UNUSED(user_data);

	if (status == HTTP_SERVER_TRANSACTION_ABORTED ||
	    status == HTTP_SERVER_TRANSACTION_COMPLETE) {
		dyn.offset = 0;
		return 0;
	}

	if (request_ctx->header_count > 0) {
		dyn_capture_request_headers(request_ctx);
	}

	switch (client->method) {
	case HTTP_GET: {
		size_t remaining = dyn.body_len - dyn.offset;
		size_t len = (dyn.chunk > 0) ? MIN(dyn.chunk, remaining) : remaining;

		response_ctx->status = dyn.status;
		response_ctx->headers = dyn.headers;
		response_ctx->header_count = dyn.header_count;
		response_ctx->body = dyn.body + dyn.offset;
		response_ctx->body_len = len;
		dyn.offset += len;
		response_ctx->final_chunk = (dyn.offset >= dyn.body_len);
		break;
	}
	case HTTP_POST:
	case HTTP_PUT:
		if (dyn.offset + request_ctx->data_len > sizeof(dyn.upload)) {
			return -ENOMEM;
		}

		if (request_ctx->data_len > 0) {
			memcpy(dyn.upload + dyn.offset, request_ctx->data, request_ctx->data_len);
			dyn.offset += request_ctx->data_len;
		}

		if (status == HTTP_SERVER_REQUEST_DATA_FINAL) {
			dyn.upload_len = dyn.offset;
			dyn.offset = 0;
			response_ctx->status = dyn.status;
			response_ctx->headers = dyn.headers;
			response_ctx->header_count = dyn.header_count;
			response_ctx->final_chunk = true;
		}

		break;
	default:
		return -ENOTSUP;
	}

	return 0;
}

static struct http_resource_detail_dynamic dynamic_detail = {
	.common = {
		.type = HTTP_RESOURCE_TYPE_DYNAMIC,
		.bitmask_of_supported_http_methods =
			BIT(HTTP_GET) | BIT(HTTP_POST) | BIT(HTTP_PUT),
	},
	.cb = dynamic_cb,
};

HTTP_RESOURCE_DEFINE(dynamic_resource, test_http_service, "/dynamic", &dynamic_detail);

/* Client under test */

static struct http_client client;
static struct http_client_transport_quic_ctx transport_ctx;
static struct http_client_session_config session_cfg;
static struct test_response rsp;
static uint8_t body_buf[BODY_BUF_SIZE];
static uint8_t large_body[LARGE_BODY_SIZE];
static uint8_t upload_pattern[UPLOAD_PATTERN_SIZE];
static bool initialized;

static int client_init(void)
{
	memset(&transport_ctx, 0, sizeof(transport_ctx));

	transport_ctx.config.sec_tag_list = client_tag_list;
	transport_ctx.config.sec_tag_count = ARRAY_SIZE(client_tag_list);
	transport_ctx.config.hostname = SERVER_HOST;

	return http_client_init_quic(&client, &transport_ctx);
}

static void session_cfg_init(struct http_client_session_config *cfg, bool async)
{
	struct net_sockaddr_in *sa = (struct net_sockaddr_in *)&cfg->server_addr;
	int ret;

	memset(cfg, 0, sizeof(*cfg));
	sa->sin_family = NET_AF_INET;
	sa->sin_port = net_htons(SERVER_PORT);
	ret = zsock_inet_pton(NET_AF_INET, SERVER_ADDR, &sa->sin_addr);
	zassert_equal(ret, 1, "inet_pton failed");
	cfg->addrlen = sizeof(*sa);
	cfg->host = SERVER_HOST;
	cfg->async = async;
}

static void client_connect(bool async)
{
	int ret;

	ret = client_init();
	zassert_ok(ret, "client init failed (%d)", ret);

	session_cfg_init(&session_cfg, async);

	ret = http_client_connect(&client, &session_cfg);
	zassert_ok(ret, "connect failed (%d)", ret);
}

static void ensure_initialized(void)
{
	int ret;

	if (initialized) {
		return;
	}

	for (size_t i = 0; i < sizeof(large_body); i++) {
		large_body[i] = (uint8_t)(i * 7 + 1);
	}

	for (size_t i = 0; i < sizeof(upload_pattern); i++) {
		upload_pattern[i] = (uint8_t)(i * 3 + 5);
	}

	ret = tls_credential_add(CA_CERTIFICATE_TAG, TLS_CREDENTIAL_CA_CERTIFICATE, ca_certificate,
				 sizeof(ca_certificate));
	zassert_ok(ret, "failed to add CA certificate (%d)", ret);

	ret = tls_credential_add(SERVER_CERTIFICATE_TAG, TLS_CREDENTIAL_PUBLIC_CERTIFICATE,
				 server_certificate, sizeof(server_certificate));
	zassert_ok(ret, "failed to add server certificate (%d)", ret);

	ret = tls_credential_add(SERVER_CERTIFICATE_TAG, TLS_CREDENTIAL_PRIVATE_KEY,
				 server_private_key, sizeof(server_private_key));
	zassert_ok(ret, "failed to add server private key (%d)", ret);

	/* Started once: the server's QUIC listener is not torn down cleanly
	 * enough to be started again in the same process.
	 */
	ret = http_server_start();
	zassert_ok(ret, "server start failed (%d)", ret);

	initialized = true;
}

static void common_before(bool async)
{
	ensure_initialized();
	dyn_reset();
	test_response_init(&rsp, body_buf, sizeof(body_buf));

	client_connect(async);
}

static void sync_before(void *fixture)
{
	ARG_UNUSED(fixture);

	common_before(false);
}

static void async_before(void *fixture)
{
	ARG_UNUSED(fixture);

	common_before(true);
}

static void common_after(void *fixture)
{
	ARG_UNUSED(fixture);

	(void)http_client_disconnect(&client);

	/* Let the server finish with the connection: a late packet of it
	 * reaching the next connection's handshake fails that one.
	 */
	k_msleep(200);
}

static int do_request(struct http_client_request *req, enum http_method method, const char *url,
		      struct test_response *r)
{
	req->method = method;
	req->url = url;
	req->response_cb = test_response_cb;

	return http_client_send_request(&client, req, TEST_REQUEST_TIMEOUT_MS, r);
}

static int do_get(const char *url, struct test_response *r)
{
	struct http_client_request req = {0};

	return do_request(&req, HTTP_GET, url, r);
}

static void assert_complete(const struct test_response *r, uint16_t status)
{
	zassert_false(r->aborted, "transaction aborted, err %d", r->error);
	zassert_equal(r->final_count, 1, "final reported %d times", r->final_count);
	zassert_equal(r->status, status, "unexpected status %u", r->status);
	zassert_false(r->body_overflow, "body buffer too small");
}

/* Synchronous sessions */

ZTEST(http3_client, test_get_static)
{
	int ret;

	ret = do_get("/static", &rsp);
	zassert_ok(ret, "GET failed (%d)", ret);
	assert_complete(&rsp, HTTP_200_OK);
	zassert_equal(rsp.header_blocks, 1, "headers reported %d times", rsp.header_blocks);
	zassert_equal(rsp.body_len, sizeof(static_payload) - 1, "body length %zu", rsp.body_len);
	zassert_mem_equal(rsp.body, static_payload, rsp.body_len, "body mismatch");
	zassert_false(rsp.content_len_present, "content length reported without header");
}

ZTEST(http3_client, test_get_dynamic_status)
{
	int ret;

	dyn.status = HTTP_404_NOT_FOUND;
	ret = do_get("/dynamic", &rsp);
	zassert_ok(ret, "GET failed (%d)", ret);
	assert_complete(&rsp, HTTP_404_NOT_FOUND);

	test_response_init(&rsp, body_buf, sizeof(body_buf));
	dyn.status = HTTP_500_INTERNAL_SERVER_ERROR;
	ret = do_get("/dynamic", &rsp);
	zassert_ok(ret, "GET failed (%d)", ret);
	assert_complete(&rsp, HTTP_500_INTERNAL_SERVER_ERROR);
}

ZTEST(http3_client, test_get_response_headers)
{
	static const char body[] = "dynamic body";
	static const struct http_header headers[] = {
		{"test-header", "value1"},
		{"content-length", "12"},
	};
	const char *value;
	int ret;

	dyn.body = body;
	dyn.body_len = sizeof(body) - 1;
	dyn.headers = headers;
	dyn.header_count = ARRAY_SIZE(headers);

	ret = do_get("/dynamic", &rsp);
	zassert_ok(ret, "GET failed (%d)", ret);
	assert_complete(&rsp, HTTP_200_OK);
	zassert_equal(rsp.header_blocks, 1, "headers reported %d times", rsp.header_blocks);

	value = test_response_header(&rsp, "test-header");
	zassert_not_null(value, "test-header missing");
	zassert_str_equal(value, "value1", "test-header value %s", value);

	zassert_true(rsp.content_len_present, "content length not reported");
	zassert_equal(rsp.content_len, 12, "content length %zu", rsp.content_len);
	zassert_equal(rsp.body_len, 12, "body length %zu", rsp.body_len);
	zassert_mem_equal(rsp.body, body, rsp.body_len, "body mismatch");
}

ZTEST(http3_client, test_method_not_allowed)
{
	struct http_client_request req = {0};
	int ret;

	ret = do_request(&req, HTTP_DELETE, "/static", &rsp);
	zassert_ok(ret, "DELETE failed (%d)", ret);
	assert_complete(&rsp, HTTP_405_METHOD_NOT_ALLOWED);
}

ZTEST(http3_client, test_put_payload)
{
	struct http_client_request req = {0};
	int ret;

	req.payload = upload_pattern;
	req.payload_len = sizeof(upload_pattern);

	ret = do_request(&req, HTTP_PUT, "/dynamic", &rsp);
	zassert_ok(ret, "PUT failed (%d)", ret);
	assert_complete(&rsp, HTTP_200_OK);
	zassert_equal(dyn.upload_len, sizeof(upload_pattern), "upload length %zu", dyn.upload_len);
	zassert_mem_equal(dyn.upload, upload_pattern, dyn.upload_len, "upload mismatch");
}

static int payload_cb(size_t offset, const uint8_t **payload, size_t *len, bool *more,
		      void *user_data)
{
	size_t chunk = MIN(600, sizeof(upload_pattern) - offset);

	ARG_UNUSED(user_data);

	*payload = upload_pattern + offset;
	*len = chunk;
	*more = (offset + chunk < sizeof(upload_pattern));

	return 0;
}

ZTEST(http3_client, test_post_payload_cb)
{
	struct http_client_request req = {0};
	int ret;

	req.payload_cb = payload_cb;

	ret = do_request(&req, HTTP_POST, "/dynamic", &rsp);
	zassert_ok(ret, "POST failed (%d)", ret);
	assert_complete(&rsp, HTTP_200_OK);
	zassert_equal(dyn.upload_len, sizeof(upload_pattern), "upload length %zu", dyn.upload_len);
	zassert_mem_equal(dyn.upload, upload_pattern, dyn.upload_len, "upload mismatch");
}

/* Reports the end of the payload with an empty final chunk. */
static int payload_cb_empty_final(size_t offset, const uint8_t **payload, size_t *len, bool *more,
				  void *user_data)
{
	size_t chunk = MIN(500, sizeof(upload_pattern) - offset);

	ARG_UNUSED(user_data);

	*payload = upload_pattern + offset;
	*len = chunk;
	*more = (chunk > 0);

	return 0;
}

ZTEST(http3_client, test_post_payload_cb_empty_final)
{
	struct http_client_request req = {0};
	int ret;

	req.payload_cb = payload_cb_empty_final;

	ret = do_request(&req, HTTP_POST, "/dynamic", &rsp);
	zassert_ok(ret, "POST failed (%d)", ret);
	assert_complete(&rsp, HTTP_200_OK);
	zassert_equal(dyn.upload_len, sizeof(upload_pattern), "upload length %zu", dyn.upload_len);
	zassert_mem_equal(dyn.upload, upload_pattern, dyn.upload_len, "upload mismatch");
}

static int headers_cb(const struct http_client_header **headers, size_t *count, bool *more,
		      void *user_data)
{
	static const struct http_client_header extra[] = {
		{"test-header2", "def"},
	};

	ARG_UNUSED(user_data);

	*headers = extra;
	*count = ARRAY_SIZE(extra);
	*more = false;

	return 0;
}

ZTEST(http3_client, test_request_headers)
{
	static const struct http_client_header fields[] = {
		{"test-header", "abc"},
	};
	struct http_client_request req = {0};
	const char *value;
	int ret;

	req.header_fields = fields;
	req.headers_count = ARRAY_SIZE(fields);
	req.headers_cb = headers_cb;

	ret = do_request(&req, HTTP_GET, "/dynamic", &rsp);
	zassert_ok(ret, "GET failed (%d)", ret);
	assert_complete(&rsp, HTTP_200_OK);

	value = dyn_request_header("test-header");
	zassert_not_null(value, "test-header not received by the server");
	zassert_str_equal(value, "abc", "test-header value %s", value);

	value = dyn_request_header("test-header2");
	zassert_not_null(value, "test-header2 not received by the server");
	zassert_str_equal(value, "def", "test-header2 value %s", value);
}

ZTEST(http3_client, test_skip_response_headers)
{
	struct http_client_request req = {0};
	int ret;

	req.skip_response_headers = true;

	ret = do_request(&req, HTTP_GET, "/static", &rsp);
	zassert_ok(ret, "GET failed (%d)", ret);
	assert_complete(&rsp, HTTP_200_OK);
	zassert_equal(rsp.header_blocks, 0, "headers reported although skipped");
	zassert_equal(rsp.header_count, 0, "headers captured although skipped");
	zassert_equal(rsp.body_len, sizeof(static_payload) - 1, "body length %zu", rsp.body_len);
}

ZTEST(http3_client, test_get_large_body)
{
	static const struct http_header headers[] = {
		{"content-type", "application/octet-stream"},
	};
	int ret;

	dyn.body = large_body;
	dyn.body_len = sizeof(large_body);
	dyn.chunk = LARGE_BODY_CHUNK;
	dyn.headers = headers;
	dyn.header_count = ARRAY_SIZE(headers);

	ret = do_get("/dynamic", &rsp);
	zassert_ok(ret, "GET failed (%d)", ret);
	assert_complete(&rsp, HTTP_200_OK);
	zassert_equal(rsp.header_blocks, 1, "headers reported %d times", rsp.header_blocks);
	zassert_true(rsp.body_chunks > 1, "body delivered in one chunk");
	zassert_equal(rsp.body_len, sizeof(large_body), "body length %zu", rsp.body_len);
	zassert_mem_equal(rsp.body, large_body, rsp.body_len, "body mismatch");
}

ZTEST(http3_client, test_abort_from_callback)
{
	int ret;

	rsp.body_cb_ret = -ECANCELED;

	ret = do_get("/static", &rsp);
	zassert_equal(ret, -ECANCELED, "unexpected result %d", ret);
	zassert_true(rsp.aborted, "abort not reported");
	zassert_equal(rsp.error, -ECANCELED, "abort reason %d", rsp.error);
	zassert_equal(rsp.final_count, 0, "final reported after abort");
}

ZTEST(http3_client, test_request_on_closed_session)
{
	int ret;

	ret = http_client_disconnect(&client);
	zassert_ok(ret, "disconnect failed (%d)", ret);

	ret = do_get("/static", &rsp);
	zassert_equal(ret, -ENOTCONN, "unexpected result %d", ret);
	zassert_true(rsp.aborted, "abort not reported");
	zassert_equal(rsp.error, -ENOTCONN, "abort reason %d", rsp.error);
}

ZTEST(http3_client, test_reconnect)
{
	int ret;

	ret = do_get("/static", &rsp);
	zassert_ok(ret, "GET failed (%d)", ret);
	assert_complete(&rsp, HTTP_200_OK);

	ret = http_client_disconnect(&client);
	zassert_ok(ret, "disconnect failed (%d)", ret);

	ret = http_client_disconnect(&client);
	zassert_ok(ret, "second disconnect failed (%d)", ret);

	/* See common_after(). */
	k_msleep(200);

	ret = http_client_connect(&client, &session_cfg);
	zassert_ok(ret, "reconnect failed (%d)", ret);

	ret = http_client_connect(&client, &session_cfg);
	zassert_equal(ret, -EALREADY, "connect on open session returned %d", ret);

	test_response_init(&rsp, body_buf, sizeof(body_buf));
	ret = do_get("/static", &rsp);
	zassert_ok(ret, "GET after reconnect failed (%d)", ret);
	assert_complete(&rsp, HTTP_200_OK);
}

ZTEST(http3_client, test_connect_invalid_addrlen)
{
	struct http_client_session_config cfg;
	int ret;

	ret = http_client_disconnect(&client);
	zassert_ok(ret, "disconnect failed (%d)", ret);

	session_cfg_init(&cfg, false);
	cfg.addrlen = 0;
	ret = http_client_connect(&client, &cfg);
	zassert_equal(ret, -EINVAL, "zero addrlen accepted (%d)", ret);

	cfg.addrlen = sizeof(cfg.server_addr) + 1;
	ret = http_client_connect(&client, &cfg);
	zassert_equal(ret, -EINVAL, "oversized addrlen accepted (%d)", ret);
}

ZTEST(http3_client, test_tls_server_name_default)
{
	struct http_client_session_config cfg;
	int ret;

	ret = http_client_disconnect(&client);
	zassert_ok(ret, "disconnect failed (%d)", ret);
	k_msleep(200);

	/* With no TLS hostname configured, the session host is sent as the
	 * server name and the certificate is verified against it.
	 */
	memset(&transport_ctx, 0, sizeof(transport_ctx));
	transport_ctx.config.sec_tag_list = client_tag_list;
	transport_ctx.config.sec_tag_count = ARRAY_SIZE(client_tag_list);
	ret = http_client_init_quic(&client, &transport_ctx);
	zassert_ok(ret, "client init failed (%d)", ret);

	session_cfg_init(&cfg, false);
	ret = http_client_connect(&client, &cfg);
	zassert_ok(ret, "connect failed (%d)", ret);
	ret = do_get("/static", &rsp);
	zassert_ok(ret, "GET failed (%d)", ret);
	assert_complete(&rsp, HTTP_200_OK);

	ret = http_client_disconnect(&client);
	zassert_ok(ret, "disconnect failed (%d)", ret);
	k_msleep(200);

	cfg.host = "other.test";
	ret = http_client_connect(&client, &cfg);
	zassert_true(ret < 0, "certificate accepted for another host (%d)", ret);
	zassert_equal(client.session.state, HTTP_CLIENT_SESSION_CLOSED, "session state %d",
		      client.session.state);
}

ZTEST_SUITE(http3_client, NULL, NULL, sync_before, common_after, NULL);

/* Asynchronous sessions */

ZTEST(http3_client_async, test_async_get)
{
	struct http_client_request req = {0};
	int ret;

	ret = do_request(&req, HTTP_GET, "/static", &rsp);
	zassert_ok(ret, "GET failed (%d)", ret);

	ret = test_response_wait(&rsp, K_SECONDS(5));
	zassert_ok(ret, "response timed out");
	assert_complete(&rsp, HTTP_200_OK);
	zassert_equal(rsp.body_len, sizeof(static_payload) - 1, "body length %zu", rsp.body_len);
	zassert_mem_equal(rsp.body, static_payload, rsp.body_len, "body mismatch");
}

ZTEST(http3_client_async, test_async_concurrent)
{
	static const char body[] = "dynamic body";
	static struct http_client_request reqs[3];
	static struct test_response rsps[3];
	static uint8_t bufs[3][2048];
	int ret;

	dyn.body = body;
	dyn.body_len = sizeof(body) - 1;

	for (int i = 0; i < 3; i++) {
		memset(&reqs[i], 0, sizeof(reqs[i]));
		test_response_init(&rsps[i], bufs[i], sizeof(bufs[i]));
	}

	ret = do_request(&reqs[0], HTTP_GET, "/static", &rsps[0]);
	zassert_ok(ret, "GET 1 failed (%d)", ret);
	ret = do_request(&reqs[1], HTTP_GET, "/dynamic", &rsps[1]);
	zassert_ok(ret, "GET 2 failed (%d)", ret);
	ret = do_request(&reqs[2], HTTP_GET, "/static", &rsps[2]);
	zassert_ok(ret, "GET 3 failed (%d)", ret);

	for (int i = 0; i < 3; i++) {
		ret = test_response_wait(&rsps[i], K_SECONDS(5));
		zassert_ok(ret, "response %d timed out", i);
		assert_complete(&rsps[i], HTTP_200_OK);
	}

	zassert_equal(rsps[0].body_len, sizeof(static_payload) - 1, "body 1 length");
	zassert_mem_equal(rsps[0].body, static_payload, rsps[0].body_len, "body 1 mismatch");
	zassert_equal(rsps[1].body_len, sizeof(body) - 1, "body 2 length");
	zassert_mem_equal(rsps[1].body, body, rsps[1].body_len, "body 2 mismatch");
	zassert_equal(rsps[2].body_len, sizeof(static_payload) - 1, "body 3 length");
	zassert_mem_equal(rsps[2].body, static_payload, rsps[2].body_len, "body 3 mismatch");
}

ZTEST(http3_client_async, test_async_abort_from_callback)
{
	struct http_client_request req = {0};
	int ret;

	rsp.body_cb_ret = -ECANCELED;

	ret = do_request(&req, HTTP_GET, "/static", &rsp);
	zassert_ok(ret, "GET failed (%d)", ret);

	ret = test_response_wait(&rsp, K_SECONDS(5));
	zassert_ok(ret, "abort timed out");
	zassert_true(rsp.aborted, "abort not reported");
	zassert_equal(rsp.error, -ECANCELED, "abort reason %d", rsp.error);
	zassert_equal(rsp.final_count, 0, "final reported after abort");
}

ZTEST_SUITE(http3_client_async, NULL, NULL, async_before, common_after, NULL);
```

## src/qpack.c
```c
/*
 * Copyright (c) 2026 Nordic Semiconductor ASA
 *
 * SPDX-License-Identifier: Apache-2.0
 */

/* The QPACK field line codec of the HTTP/3 client, which keeps no dynamic
 * table.
 */

#include <string.h>

#include <zephyr/ztest.h>

#include "client_internal.h"

static uint8_t scratch[64];

static void assert_field(const struct h3_field *f, const char *name, const char *value)
{
	zassert_equal(f->name_len, strlen(name), "name length %zu", f->name_len);
	zassert_mem_equal(f->name, name, f->name_len, "name mismatch");
	zassert_equal(f->value_len, strlen(value), "value length %zu", f->value_len);
	zassert_mem_equal(f->value, value, f->value_len, "value mismatch");
}

static void roundtrip(const char *name, const char *value, int expected_len)
{
	uint8_t buf[64];
	struct h3_field f;
	int len;
	int ret;

	len = qpack_encode_field(buf, sizeof(buf), name, value);
	zassert_true(len > 0, "encode failed (%d)", len);
	if (expected_len > 0) {
		zassert_equal(len, expected_len, "encoded %s in %d bytes", name, len);
	}

	ret = qpack_decode_field(buf, len, &f, scratch, sizeof(scratch));
	zassert_equal(ret, len, "decoded %d of %d bytes", ret, len);
	assert_field(&f, name, value);

	/* A truncated line asks for more data. */
	ret = qpack_decode_field(buf, len - 1, &f, scratch, sizeof(scratch));
	zassert_equal(ret, -EAGAIN, "truncated line returned %d", ret);
}

ZTEST(http3_qpack, test_static_indexed)
{
	/* :method GET is static entry 17, one byte. */
	roundtrip(":method", "GET", 1);
	roundtrip(":scheme", "https", 1);
}

ZTEST(http3_qpack, test_static_name_ref)
{
	/* :path has entry 1; the value goes literally. */
	roundtrip(":path", "/dynamic", 2 + 8);
	roundtrip(":authority", "localhost", 2 + 9);
}

ZTEST(http3_qpack, test_literal_name)
{
	/* An 11-byte name overflows the 3-bit length prefix into a second byte. */
	roundtrip("test-header", "abc", 2 + 11 + 1 + 3);
	roundtrip("x-empty", "", 0);
}

ZTEST(http3_qpack, test_huffman_value)
{
	/* :authority with "www.example.com" Huffman-coded (RFC 7541, C.4.1). */
	static const uint8_t line[] = {
		0x50, 0x8c, 0xf1, 0xe3, 0xc2, 0xe5, 0xf2, 0x3a, 0x6b, 0xa0, 0xab, 0x90, 0xf4, 0xff,
	};
	struct h3_field f;
	int ret;

	ret = qpack_decode_field(line, sizeof(line), &f, scratch, sizeof(scratch));
	zassert_equal(ret, sizeof(line), "decoded %d bytes", ret);
	assert_field(&f, ":authority", "www.example.com");

	/* Too little room to decode into is not a malformed line. */
	ret = qpack_decode_field(line, sizeof(line), &f, scratch, 4);
	zassert_equal(ret, -ENOBUFS, "small scratch returned %d", ret);
}

ZTEST(http3_qpack, test_static_no_value)
{
	/* Indexed :authority (entry 0) has no value in the table. */
	static const uint8_t line[] = {0xc0};
	struct h3_field f;
	int ret;

	ret = qpack_decode_field(line, sizeof(line), &f, scratch, sizeof(scratch));
	zassert_equal(ret, 1, "decoded %d bytes", ret);
	assert_field(&f, ":authority", "");
}

ZTEST(http3_qpack, test_dynamic_refused)
{
	static const uint8_t indexed_dynamic[] = {0x80};
	static const uint8_t name_ref_dynamic[] = {0x40, 0x01, 'x'};
	static const uint8_t post_base[] = {0x10};
	static const uint8_t bad_static[] = {0xff, 0x7f};
	struct h3_field f;

	zassert_equal(qpack_decode_field(indexed_dynamic, 1, &f, scratch, sizeof(scratch)),
		      -EBADMSG);
	zassert_equal(qpack_decode_field(name_ref_dynamic, 3, &f, scratch, sizeof(scratch)),
		      -EBADMSG);
	zassert_equal(qpack_decode_field(post_base, 1, &f, scratch, sizeof(scratch)), -EBADMSG);
	/* Static index 63 + 127 is past the table. */
	zassert_equal(qpack_decode_field(bad_static, 2, &f, scratch, sizeof(scratch)), -EBADMSG);
}

ZTEST(http3_qpack, test_encode_no_room)
{
	uint8_t buf[4];

	zassert_true(qpack_encode_field(buf, sizeof(buf), "test-header", "abc") < 0,
		     "encoded into a short buffer");
}

ZTEST_SUITE(http3_qpack, NULL, NULL, NULL, NULL, NULL);
```
